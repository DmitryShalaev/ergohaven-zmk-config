## config/west.yml
```yaml
manifest:
  remotes:
    - name: ergohaven
      url-base: https://github.com/ergohaven
    - name: dmitryshalaev
      url-base: https://github.com/DmitryShalaev
  projects:
    - name: ergohaven-zmk-qube
      remote: dmitryshalaev
      revision: a558acadf7ce36e0dba1621f19987d4d6791373b
    - name: ergohaven-zmk
      remote: ergohaven
      revision: main
      import: config/west.yml
  self:
    path: config
```
